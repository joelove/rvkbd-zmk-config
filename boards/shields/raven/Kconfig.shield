## boards/shields/raven/Kconfig.shield
```kconfig
# Copyright (c) 2020 Pete Johanson
# SPDX-License-Identifier: MIT

config SHIELD_RAVEN_LEFT
    def_bool $(shields_list_contains,raven_left)

config SHIELD_RAVEN_RIGHT
    def_bool $(shields_list_contains,raven_right)
```
