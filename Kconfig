## Kconfig
```kconfig
# Copyright (c) 2026 Joe Love
# SPDX-License-Identifier: MIT

rsource "drivers/Kconfig"
```

## drivers/sensor/battery_soc_map/Kconfig
```kconfig
# Copyright (c) 2026 Joe Love
# SPDX-License-Identifier: MIT

config RAVEN_BATTERY_SOC_MAP
	bool "Raven battery voltage to state-of-charge map"
	default y
	depends on DT_HAS_RAVEN_BATTERY_SOC_MAP_ENABLED
	select SENSOR
	help
	  Read a voltage sensor and convert millivolts to a Bluetooth
	  battery percentage using a shield-defined lookup table.
```

## dts/bindings/sensor/raven,battery-soc-map.yaml
```yaml
# Copyright (c) 2026 Joe Love
# SPDX-License-Identifier: MIT

description: Map a battery voltage sensor to a state-of-charge percent

compatible: "raven,battery-soc-map"

properties:
  voltage-sensor:
    type: phandle
    required: true
    description: Sensor that reports SENSOR_CHAN_GAUGE_VOLTAGE

  voltage-mv:
    type: array
    required: true
    description: Battery voltages in millivolts, strictly decreasing (full to empty)

  percent:
    type: array
    required: true
    description: Percents matching voltage-mv, full to empty
```
